/dts-v1/;
/plugin/;

/ {
    compatible = "brcm,bcm2711"; // RaspberryPi 4B랑 호환

    fragment@0 {
        target = <&spi0>; // SPI0 버스 타깃
        __overlay__ {
            st7735@0 {
                compatible = "my-custom,st7735"; // 장치 고유 식별이름
                
                reg = <0>; // CS 0 (CE0, BCM 8) // 나머지 자동 설정
                spi-max-frequency = <16000000>; //16MHz

                reset-gpios = <&gpio 22 0>; // reset BCM 22
                dc-gpios = <&gpio 17 0>;    // data connection BCM 17, Active High 1주면 켜짐
                
                bl-gpios = <&gpio 27 0>; // back light BCM27
            };
        };
    };
};
